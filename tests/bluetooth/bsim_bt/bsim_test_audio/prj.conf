## prj.conf
```kconfig
CONFIG_TEST=y
CONFIG_BT_TESTING=y
CONFIG_CONSOLE_HANDLER=y
CONFIG_USERSPACE=n
CONFIG_NO_OPTIMIZATIONS=y

CONFIG_BT=y
CONFIG_BT_CENTRAL=y
CONFIG_BT_PERIPHERAL=y
CONFIG_BT_DEVICE_NAME="bsim_test_audio"
CONFIG_BT_L2CAP_TX_BUF_COUNT=20
CONFIG_BT_MAX_CONN=5
CONFIG_BT_MAX_PAIRED=5
CONFIG_BT_GATT_DYNAMIC_DB=y
CONFIG_BT_SMP=y

# Needed for extended advertising
CONFIG_BT_EXT_ADV_LEGACY_SUPPORT=y

# Advertising Extensions support in Controller
CONFIG_BT_CTLR_ADV_EXT=y
CONFIG_BT_CTLR_ADV_DATA_LEN_MAX=255
CONFIG_BT_CTLR_SCAN_DATA_LEN_MAX=255

CONFIG_BT_AUDIO=y
CONFIG_BT_AUDIO_UNICAST_SERVER=y
CONFIG_BT_AUDIO_UNICAST_CLIENT=y
CONFIG_BT_AUDIO_UNICAST_CLIENT_GROUP_STREAM_COUNT=2
CONFIG_BT_AUDIO_BROADCAST_SOURCE=y
CONFIG_BT_AUDIO_BROADCAST_SINK=y
CONFIG_BT_AUDIO_BROADCAST_SRC_STREAM_COUNT=2
CONFIG_BT_AUDIO_BROADCAST_SNK_STREAM_COUNT=2

# Volume Offset Control Service
CONFIG_BT_VOCS_MAX_INSTANCE_COUNT=2
CONFIG_BT_VOCS_CLIENT_MAX_INSTANCE_COUNT=2

# Audio Input Control Service
CONFIG_BT_AICS_MAX_INSTANCE_COUNT=4
CONFIG_BT_AICS_CLIENT_MAX_INSTANCE_COUNT=4

#Volume Control
CONFIG_BT_VCS=y
CONFIG_BT_VCS_VOCS_INSTANCE_COUNT=2
CONFIG_BT_VCS_AICS_INSTANCE_COUNT=2
CONFIG_BT_VCS_CLIENT=y
CONFIG_BT_VCS_CLIENT_MAX_VOCS_INST=2
CONFIG_BT_VCS_CLIENT_MAX_AICS_INST=2

CONFIG_BT_MICS=y
CONFIG_BT_MICS_AICS_INSTANCE_COUNT=2
CONFIG_BT_MICS_CLIENT=y
CONFIG_BT_MICS_CLIENT_MAX_AICS_INST=2

# Coordinated Set Identification
CONFIG_BT_CSIS=y
CONFIG_BT_CSIS_TEST_SAMPLE_DATA=y
CONFIG_BT_CSIS_CLIENT=y
CONFIG_BT_CSIS_CLIENT_TEST_SAMPLE_DATA=y

# Telephone bearer service
CONFIG_BT_TBS=y
CONFIG_BT_TBS_CLIENT=y

# Media control
CONFIG_MCTL=y
CONFIG_MCTL_LOCAL_PLAYER_CONTROL=y
CONFIG_MCTL_LOCAL_PLAYER_LOCAL_CONTROL=y
CONFIG_MCTL_LOCAL_PLAYER_REMOTE_CONTROL=y
CONFIG_MCTL_REMOTE_PLAYER_CONTROL=y
CONFIG_MCTL_REMOTE_PLAYER_CONTROL_OBJECTS=y
CONFIG_UTF8=y

# Media player
CONFIG_BT_MPL=y
CONFIG_BT_MPL_OBJECTS=y
CONFIG_BT_MPL_MAX_OBJ_SIZE=600

# Media control
CONFIG_BT_MCS=y
CONFIG_BT_MCC=y
CONFIG_BT_MCC_OTS=y
CONFIG_BT_MCC_SHELL=y
CONFIG_BT_MCC_TOTAL_OBJ_CONTENT_MEM=4096

# Object Transfer
CONFIG_BT_OTS=y
CONFIG_BT_OTS_SECONDARY_SVC=y
CONFIG_BT_OTS_MAX_OBJ_CNT=0x30
CONFIG_BT_OTS_CLIENT=y

# Broadcast Audio Scan Service and client
CONFIG_BT_BASS=y
CONFIG_BT_BASS_CLIENT=y

# Hearing Access
CONFIG_BT_HAS=y
CONFIG_BT_HAS_CLIENT=y
CONFIG_BT_HAS_HEARING_AID_MONAURAL=y
CONFIG_BT_SMP_SC_PAIR_ONLY=y
CONFIG_BT_SMP_MIN_ENC_KEY_SIZE=16

CONFIG_BT_CAP_ACCEPTOR_SET_MEMBER=y
# DEBUGGING
CONFIG_BT_DEBUG_LOG=y
CONFIG_BT_DEBUG_VCS=y
CONFIG_BT_DEBUG_VCS_CLIENT=y
CONFIG_BT_DEBUG_AICS=y
CONFIG_BT_DEBUG_AICS_CLIENT=y
CONFIG_BT_DEBUG_VOCS=y
CONFIG_BT_DEBUG_VOCS_CLIENT=y
CONFIG_BT_DEBUG_MICS=y
CONFIG_BT_DEBUG_MICS_CLIENT=y
CONFIG_BT_DEBUG_MPL=y
CONFIG_BT_DEBUG_TBS=y
CONFIG_BT_DEBUG_TBS_CLIENT=y
CONFIG_BT_DEBUG_MCS=y
CONFIG_BT_DEBUG_MCC=y
CONFIG_BT_OTS_LOG_LEVEL_DBG=y
CONFIG_BT_DEBUG_OTS_CLIENT=y
CONFIG_MCTL_DEBUG=y
CONFIG_BT_DEBUG_CSIS=y
CONFIG_BT_DEBUG_CSIS_CLIENT=y
CONFIG_BT_DEBUG_CSIS_CRYPTO=y
CONFIG_BT_AUDIO_DEBUG_UNICAST_CLIENT=y
CONFIG_BT_AUDIO_DEBUG_UNICAST_SERVER=y
CONFIG_BT_DEBUG_ASCS=y
CONFIG_BT_DEBUG_PACS=y
CONFIG_BT_AUDIO_DEBUG_STREAM=y
CONFIG_BT_AUDIO_DEBUG_CAPABILITIES=y
CONFIG_BT_DEBUG_BASS=y
CONFIG_BT_DEBUG_BASS_CLIENT=y
CONFIG_BT_DEBUG_HAS=y
CONFIG_BT_DEBUG_HAS_CLIENT=y

# LOGGING
CONFIG_TEST_LOGGING_DEFAULTS=n
CONFIG_LOG_MODE_IMMEDIATE=y
```

## src/main.c
```c
/*
 * Copyright (c) 2020-2022 Nordic Semiconductor ASA
 *
 * SPDX-License-Identifier: Apache-2.0
 */

#include "bstests.h"

extern struct bst_test_list *test_vcs_install(struct bst_test_list *tests);
extern struct bst_test_list *test_vcs_client_install(struct bst_test_list *tests);
extern struct bst_test_list *test_mics_install(struct bst_test_list *tests);
extern struct bst_test_list *test_mics_client_install(struct bst_test_list *tests);
extern struct bst_test_list *test_csis_install(struct bst_test_list *tests);
extern struct bst_test_list *test_csis_client_install(struct bst_test_list *tests);
extern struct bst_test_list *test_mcs_install(struct bst_test_list *tests);
extern struct bst_test_list *test_mcc_install(struct bst_test_list *tests);
extern struct bst_test_list *test_media_controller_install(struct bst_test_list *tests);
extern struct bst_test_list *test_unicast_client_install(struct bst_test_list *tests);
extern struct bst_test_list *test_unicast_server_install(struct bst_test_list *tests);
extern struct bst_test_list *test_broadcast_source_install(struct bst_test_list *tests);
extern struct bst_test_list *test_broadcast_sink_install(struct bst_test_list *tests);
extern struct bst_test_list *test_has_install(struct bst_test_list *tests);
extern struct bst_test_list *test_has_client_install(struct bst_test_list *tests);

bst_test_install_t test_installers[] = {
	test_vcs_install,
	test_vcs_client_install,
	test_mics_install,
	test_mics_client_install,
	test_csis_install,
	test_csis_client_install,
	test_mcs_install,
	test_mcc_install,
	test_media_controller_install,
	test_unicast_client_install,
	test_unicast_server_install,
	test_broadcast_source_install,
	test_broadcast_sink_install,
	test_has_install,
	test_has_client_install,
	NULL
};

void main(void)
{
	bst_main();
}
```

## src/has_client_test.c
```c
/*
 * Copyright (c) 2022 Codecoup
 *
 * SPDX-License-Identifier: Apache-2.0
 */

#ifdef CONFIG_BT_HAS_CLIENT
#include "bluetooth/audio/has.h"
#include "common.h"

extern enum bst_result_t bst_result;

static volatile bool g_bt_init;
static volatile bool g_is_connected;
static volatile bool g_mtu_exchanged;
static volatile bool g_has_discovered;
static volatile bool g_active_preset_notified;
static volatile bool g_preset_read;

static struct bt_conn *g_conn;
static struct bt_has *g_has;
static volatile uint8_t g_active_preset_id;

static void discover_cb(struct bt_conn *conn, struct bt_has *has, bt_has_hearing_aid_type_t type)
{
	if (!has) {
		FAIL("Failed to discover HAS\n");
		return;
	}

	printk("HAS discovered (type %d)\n", type);

	g_has = has;
	g_has_discovered = true;
}

static void active_preset_cb(struct bt_has *has, int err, uint8_t id)
{
	if (err != 0) {
		FAIL("Failed to get active preset (err %d)\n", err);
		return;
	}

	g_active_preset_id = id;
	g_active_preset_notified = true;
}

static void preset_cb(struct bt_has *has, int err, uint8_t id, uint8_t properties, const char *name)
{
	printk("id %d properties 0x%02x name %s\n", id, properties, name);
}

static void preset_read_complete_cb(struct bt_has *has, int err)
{
	g_preset_read = true;
}

static struct bt_has_client_cb has_cb = {
	.discover = discover_cb,
	.active_preset = active_preset_cb,
	.preset = preset_cb,
	.preset_read_complete = preset_read_complete_cb,
};

static void connected(struct bt_conn *conn, uint8_t err)
{
	char addr[BT_ADDR_LE_STR_LEN];

	bt_addr_le_to_str(bt_conn_get_dst(conn), addr, sizeof(addr));

	if (err > 0) {
		FAIL("Failed to connect to %s (err %u)\n", addr, err);
		return;
	}
	printk("Connected to %s\n", addr);
	g_conn = conn;
	g_is_connected = true;
}

BT_CONN_CB_DEFINE(conn_callbacks) = {
	.connected = connected,
	.disconnected = disconnected,
};

static void bt_ready(int err)
{
	if (err != 0) {
		FAIL("Bluetooth discover failed (err %d)\n", err);
		return;
	}

	g_bt_init = true;
}

static void mtu_cb(struct bt_conn *conn, uint8_t err, struct bt_gatt_exchange_params *params)
{
	if (err > 0) {
		FAIL("Failed to exchange MTU (err %u)\n", err);
		return;
	}

	g_mtu_exchanged = true;
}

static void test_main(void)
{
	int err;
	uint8_t id_prev, id_curr;

	static struct bt_gatt_exchange_params mtu_params = {
		.func = mtu_cb,
	};

	err = bt_enable(bt_ready);
	if (err < 0) {
		FAIL("Bluetooth discover failed (err %d)\n", err);
		return;
	}

	printk("Bluetooth initialized\n");

	WAIT_FOR(g_bt_init);

	err = bt_has_client_cb_register(&has_cb);
	if (err < 0) {
		FAIL("Callback registration (err %d)\n", err);
		return;
	}

	err = bt_le_scan_start(BT_LE_SCAN_PASSIVE, device_found);
	if (err < 0) {
		FAIL("Scanning failed to start (err %d)\n", err);
		return;
	}

	printk("Scanning succesfuly started\n");

	WAIT_FOR(g_is_connected);

	err = bt_gatt_exchange_mtu(g_conn, &mtu_params);
	if (err < 0) {
		FAIL("Failed to exchange MTU (err %d)\n", err);
		return;
	}

	err = bt_has_discover(g_conn);
	if (err < 0) {
		FAIL("Failed to discover HAS (err %d)\n", err);
		return;
	}

	WAIT_FOR(g_has_discovered);

	err = bt_has_preset_active_get(g_has);
	if (err < 0) {
		FAIL("Failed to get active preset id (err %d)\n", err);
		return;
	}

	WAIT_FOR(g_active_preset_notified);

	printk("Got active preset id %d\n", g_active_preset_id);

	id_prev = g_active_preset_id;

	/* Reset the notification indicator */
	g_active_preset_notified = false;

	err = bt_has_preset_active_set_next(g_has);
	if (err < 0) {
		FAIL("Failed to set next (err %d)\n", err);
		return;
	}

	WAIT_FOR(g_active_preset_notified);

	id_curr = g_active_preset_id;

	if (id_curr == id_prev) {
		FAIL("Preset not changed");
		return;
	}

	printk("Got active preset id %d\n", g_active_preset_id);

	id_prev = g_active_preset_id;

	/* Reset the notification indicator */
	g_active_preset_notified = false;

	err = bt_has_preset_active_set_next(g_has);
	if (err < 0) {
		FAIL("Failed to set next (err %d)\n", err);
		return;
	}

	WAIT_FOR(g_active_preset_notified);

	id_curr = g_active_preset_id;

	if (id_curr == id_prev) {
		FAIL("Preset not changed");
		return;
	}

	printk("Got active preset id %d\n", g_active_preset_id);

	/* Reset the notification indicator */
	g_active_preset_notified = false;

	err = bt_has_preset_active_set_prev(g_has);
	if (err < 0) {
		FAIL("Failed to set prev (err %d)\n", err);
		return;
	}

	WAIT_FOR(g_active_preset_notified);

	id_curr = g_active_preset_id;

	if (id_curr != id_prev) {
		FAIL("Failed to set to previous %d != %d\n", id_curr, id_prev);
		return;
	}

	printk("Got active preset id %d\n", g_active_preset_id);

	err = bt_has_preset_active_clear(g_has);
	if (err == 0) {
		FAIL("Client cannot perform Active Preset clear operation\n");
		return;
	}

	err = bt_has_preset_read_multiple(g_has, 0x01, 0xff);
	if (err < 0) {
		FAIL("Failed to read all presets (err %d)\n", err);
		return;
	}

	WAIT_FOR(g_preset_read);

	err = bt_has_preset_name_set(g_has, id_curr, "Custom");
	if (err < 0) {
		FAIL("Failed to set name (err %d)\n", err);
		return;
	}

	k_sleep(K_MSEC(100));

	g_preset_read = false;

	err = bt_has_preset_read_multiple(g_has, 0x01, 0xff);
	if (err < 0) {
		FAIL("Failed to read all presets (err %d)\n", err);
		return;
	}

	WAIT_FOR(g_preset_read);

	PASS("HAS main PASS\n");
}

static const struct bst_test_instance test_has[] = { { .test_id = "has_client",
						       .test_post_init_f = test_init,
						       .test_tick_f = test_tick,
						       .test_main_f = test_main },
						     BSTEST_END_MARKER };

struct bst_test_list *test_has_client_install(struct bst_test_list *tests)
{
	return bst_add_tests(tests, test_has);
}
#else
struct bst_test_list *test_has_client_install(struct bst_test_list *tests)
{
	return tests;
}

#endif /* CONFIG_BT_HAS_CLIENT */
```

## src/has_test.c
```c
/*
 * Copyright (c) 2022 Codecoup
 *
 * SPDX-License-Identifier: Apache-2.0
 */

#ifdef CONFIG_BT_HAS
#include "bluetooth/audio/has.h"
#include "common.h"

extern enum bst_result_t bst_result;

static volatile bool g_is_connected;

static struct bt_conn *g_conn;
static struct bt_has *g_has;

static const uint8_t g_universal_idx = 1;
static const uint8_t g_outdoor_idx = 5;
static const uint8_t g_noisy_idx = 8;
static const uint8_t g_office_idx = 22;

static int set_active_preset(struct bt_has *has, uint8_t index, bool sync)
{
	int err;

	printk("Set active preset index 0x%02x sync %d\n", index, sync);

	/* Dummy set the active preset */
	err = bt_has_preset_active_set(has, index);
	if (err < 0) {
		printk("Set active failed (err %d)", err);
	}

	return err;
}

struct bt_has_preset_ops preset_ops = {
	.active_set = set_active_preset,
};

static void connected(struct bt_conn *conn, uint8_t err)
{
	char addr[BT_ADDR_LE_STR_LEN];

	bt_addr_le_to_str(bt_conn_get_dst(conn), addr, sizeof(addr));

	if (err) {
		FAIL("Failed to connect to %s (err %u)\n", addr, err);
		return;
	}
	printk("Connected to %s\n", addr);

	g_conn = conn;
	g_is_connected = true;
}

BT_CONN_CB_DEFINE(conn_callbacks) = {
	.connected = connected,
	.disconnected = disconnected,
};

static void test_standalone(void)
{
	int err;
	struct bt_has_register_param register_param = {
		.preset_param = {
			{.idx = g_universal_idx,
			.properties = BT_HAS_PROP_WRITABLE | BT_HAS_PROP_AVAILABLE,
			.name = "Universal"},
		},
		.ops = &preset_ops,
	};

	err = bt_enable(NULL);
	if (err) {
		FAIL("Bluetooth init failed (err %d)\n", err);
		return;
	}

	printk("Bluetooth initialized\n");

	err = bt_has_register(&register_param, &g_has);
	if (err) {
		FAIL("HAS register failed (err %d)\n", err);
		return;
	}

	PASS("HAS standalone passed\n");
}

static void test_main(void)
{
	int err;
	struct bt_has_register_param register_param = {
		.preset_param = {
			{.idx = g_universal_idx,
			.properties = BT_HAS_PROP_WRITABLE | BT_HAS_PROP_AVAILABLE,
			.name = "Universal"},
			{.idx = g_outdoor_idx,
			.properties = BT_HAS_PROP_WRITABLE | BT_HAS_PROP_AVAILABLE,
			.name = "Outdoor"},
			{.idx = g_noisy_idx,
			.properties = BT_HAS_PROP_WRITABLE | BT_HAS_PROP_AVAILABLE,
			.name = "Noisy environment"},
			{.idx = g_office_idx,
			.properties = BT_HAS_PROP_WRITABLE | BT_HAS_PROP_AVAILABLE,
			.name = "Office"},
		},
		.ops = &preset_ops,
	};

	err = bt_enable(NULL);

	if (err) {
		FAIL("Bluetooth discover failed (err %d)\n", err);
		return;
	}

	printk("Bluetooth initialized\n");

	err = bt_has_register(&register_param, &g_has);
	if (err) {
		FAIL("HAS register failed (err %d)\n", err);
		return;
	}

	printk("HAS initialized\n");

	err = bt_le_adv_start(BT_LE_ADV_CONN_NAME, ad, AD_SIZE, NULL, 0);
	if (err) {
		FAIL("Advertising failed to start (err %d)\n", err);
		return;
	}

	printk("Advertising successfully started\n");

	PASS("HAS passed\n");
}

static const struct bst_test_instance test_has[] = { { .test_id = "has_standalone",
						       .test_post_init_f = test_init,
						       .test_tick_f = test_tick,
						       .test_main_f = test_standalone },
						     { .test_id = "has",
						       .test_post_init_f = test_init,
						       .test_tick_f = test_tick,
						       .test_main_f = test_main },
						     BSTEST_END_MARKER };

struct bst_test_list *test_has_install(struct bst_test_list *tests)
{
	return bst_add_tests(tests, test_has);
}
#else
struct bst_test_list *test_has_install(struct bst_test_list *tests)
{
	return tests;
}

#endif /* CONFIG_BT_HAS */
```
