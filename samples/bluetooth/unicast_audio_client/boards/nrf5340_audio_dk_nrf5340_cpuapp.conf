## samples/bluetooth/unicast_audio_client/boards/nrf5340_audio_dk_nrf5340_cpuapp.conf
```kconfig
# For LC3 the following configs are needed
CONFIG_FPU=y
CONFIG_LIBLC3CODEC=y
# The LC3 codec uses a large amount of stack. This app runs the codec in the work-queue, hence
# inctease stack size for that thread.
CONFIG_SYSTEM_WORKQUEUE_STACK_SIZE=4096
# LC3 lib requires floating point support in the c-lib NEWLIB is one way of getting that.
CONFIG_NEWLIB_LIBC=y

# Not supported on Packetcraft controller
CONFIG_BT_ATT_ENFORCE_FLOW=n
# Disable Zephyr HCI Vendor-Specific extensions
CONFIG_BT_HCI_VS_EXT=n
```

## subsys/bluetooth/audio/Kconfig.cap
```kconfig
# Bluetooth Audio - Common Audio Profile (CAP) options
#
# Copyright (c) 2022 Nordic Semiconductor ASA
#
# SPDX-License-Identifier: Apache-2.0
#

config BT_CAP
	bool
	help
	  Hidden Kconfig to enable cross-role CAP capabilities.

config BT_CAP_ACCEPTOR
	bool "Common Audio Profile Acceptor Role Support [EXPERIMENTAL]"
	depends on BT_AUDIO_UNICAST_SERVER || (BT_AUDIO_BROADCAST_SINK && BT_BASS)
	select EXPERIMENTAL
	select BT_CAP

config BT_DEBUG_CAP_ACCEPTOR
	bool "Common Audio Profile Acceptor debug"
	depends on BT_CAP_ACCEPTOR
	help
	  Use this option to enable CAP Acceptor debug logs for the
	  Bluetooth Audio functionality.
```

## subsys/bluetooth/audio/Kconfig.has
```kconfig
# Bluetooth Audio - Hearing Access Service options
#
# Copyright (c) 2022 Codecoup
#
# SPDX-License-Identifier: Apache-2.0
#

if BT_AUDIO

config BT_HAS
	bool "Hearing Access Service support [EXPERIMENTAL]"
	select EXPERIMENTAL
	help
	  This option enables support for Hearing Access Service.

if BT_HAS
choice BT_HAS_TYPE
	prompt "Hearing Aid Type selection"
	help
	  Select the Hearing Aid Type to compile.

config BT_HAS_HA_TYPE_MONAURAL
	bool "Monaural Hearing Aid"

config BT_HAS_HA_TYPE_BINAURAL
	bool "Binaural Hearing Aid"

config BT_HAS_HA_TYPE_BANDED
	bool "Banded Hearing Aid"

endchoice # BT_HAS_HA_TYPE

config BT_HAS_IDENTICAL_PRESET_RECORDS
	bool "Identical preset records in Binaural Hearing Aid Set"
	depends on BT_HAS_HA_TYPE_BINAURAL
	help
	  Set if the list of preset records is identical the list of preset records
	  on the other member in the Binaural Hearing Aid Set.
	  This option sets Independent Presets field in Hearing Aid Features to 0b0.

config BT_HAS_PRESET_SYNC_SUPPORT
	bool "Preset synchronization support"
	depends on BT_HAS_HA_TYPE_BINAURAL && BT_HAS_HA_IDENTICAL_PRESET_RECORDS
	help
	  Set if there is support for active preset changes relay to the other
	  member in the Binaural Hearing Aid Set.

endif # BT_HAS

config BT_HAS_CLIENT
	bool "Hearing Access Service support [EXPERIMENTAL]"
	select EXPERIMENTAL
	help
	  This option enables support for Hearing Access Service client.

if BT_HAS_CLIENT
config BT_HAS_CLIENT_HA_COUNT
	int "Maximum number of connected Hearing Aid devices"
	default 2
	help
	  Maximum number of simultanously connected Hearing Aid devices
endif # BT_HAS_CLIENT

if BT_HAS || BT_HAS_CLIENT
config BT_DEBUG_HAS
	bool "Hearing Access Service debug"
	depends on BT_AUDIO_DEBUG
	help
	  This hidden option enables enables Hearing Access Service debug logs.

config BT_HAS_PRESET_COUNT
	int "Preset record list size"
	default 3
	range 0 10
	help
	  This option sets the number of Hearing Access Service Preset instances
	  that can be maintained as client or server.
	  Setting this to 0 disables Set Active Preset by Index and Write Preset
	  Name procedure client support.
endif # BT_HAS || BT_HAS_CLIENT

endif # BT_AUDIO
```

## subsys/bluetooth/services/Kconfig.ias
```kconfig
# Bluetooth GATT Immediate Alert Service

# Copyright (c) 2018 Nordic Semiconductor ASA
# SPDX-License-Identifier: Apache-2.0

menuconfig BT_IAS
	bool "Enable GATT Immediate Alert Service"
	select SENSOR

if BT_IAS

choice BT_IAS_DEFAULT_PERM
	prompt "Default permissions used for IAS characteristics"
	default BT_IAS_DEFAULT_PERM_RW
	help
	  Default permissions for IAS characteristic attributes
	  used when no permission is set for the report.
	  Used also for boot reports.

config BT_IAS_DEFAULT_PERM_RW
	bool "Read and write allowed"

config BT_IAS_DEFAULT_PERM_RW_ENCRYPT
	bool "Require encryption for access"

config BT_IAS_DEFAULT_PERM_RW_AUTHEN
	bool "Require encryption and authentication for access"

endchoice

module = BT_IAS
module-str = IAS
source "${ZEPHYR_BASE}/subsys/logging/Kconfig.template.log_config"

endif # BT_IAS
```
